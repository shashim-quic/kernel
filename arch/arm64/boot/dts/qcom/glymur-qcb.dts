// SPDX-License-Identifier: BSD-3-Clause
/*
 * Copyright (c) Qualcomm Technologies, Inc. and/or its subsidiaries.
 */

/dts-v1/;

#include "glymur.dtsi"
#include "glymur-qcb.dtsi"

/ {
	model = "Qualcomm Technologies, Inc. Glymur QCB";
	compatible = "qcom,glymur-qcb", "qcom,glymur";
};

&tcsr {
	vdda-qrefrpt0-0p9-supply = <&vreg_l2f_e1_0p83>;
	vdda-qrefrpt1-0p9-supply = <&vreg_l2f_e1_0p83>;
	vdda-qrefrpt2-0p9-supply = <&vreg_l2f_e1_0p83>;
	vdda-qrefrpt3-0p9-supply = <&vreg_l2h_e0_0p72>;
	vdda-qrefrpt4-0p9-supply = <&vreg_l2h_e0_0p72>;
	vdda-qrefrx0-0p9-supply = <&vreg_l2f_e1_0p83>;
	vdda-qrefrx1-0p9-supply = <&vreg_l2f_e1_0p83>;
	vdda-qrefrx2-0p9-supply = <&vreg_l2f_e1_0p83>;
	vdda-qrefrx4-0p9-supply = <&vreg_l2h_e0_0p72>;
	vdda-qrefrx5-0p9-supply = <&vreg_l3f_e0_0p72>;
	vdda-qreftx0-0p9-supply = <&vreg_l3f_e0_0p72>;
	vdda-qreftx0-1p2-supply = <&vreg_l4h_e0_1p2>;
	vdda-qreftx1-0p9-supply = <&vreg_l1f_e1_0p82>;
	vdda-refgen3-0p9-supply = <&vreg_l2f_e0_0p82>;
	vdda-refgen3-1p2-supply = <&vreg_l4h_e0_1p2>;
	vdda-refgen4-0p9-supply = <&vreg_l1f_e1_0p82>;
	vdda-refgen4-1p2-supply = <&vreg_l4f_e1_1p08>;
};

&ufs_mem_phy {
	vdda-phy-supply = <&vreg_l1c_e1_0p82>;
	vdda-pll-supply = <&vreg_l4f_e1_1p08>;

	status = "okay";
};

&ufs_mem_hc {
	reset-gpios = <&tlmm 250 GPIO_ACTIVE_LOW>;

	vcc-supply = <&vreg_l17b_e0_2p4>;
	vcc-max-microamp = <1200000>;
	vccq-supply = <&vreg_l12b_e0_1p14>;
	vccq-max-microamp = <1200000>;

	status = "okay";
};
